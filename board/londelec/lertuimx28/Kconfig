## board/londelec/lertuimx28/Kconfig
```kconfig
if TARGET_LERTUIMX28

config SYS_BOARD
	default "lertuimx28"

config SYS_VENDOR
	default "londelec"

config SYS_SOC
	default "mxs"

config SYS_CONFIG_NAME
	default "mx28_lertu"

endif
```

## board/londelec/rtuimx287/Kconfig
```kconfig
if TARGET_RTUIMX287

config SYS_CPU
	default "arm926ejs"

config SYS_BOARD
	default "rtuimx287"

config SYS_VENDOR
	default "londelec"

config SYS_SOC
	default "mxs"

config SYS_CONFIG_NAME
	default "rtuimx287"

endif
```

## configs/mx28_lertu_defconfig
```kconfig
CONFIG_ARM=y
CONFIG_ARCH_MX28=y
CONFIG_TEXT_BASE=0x40002000
CONFIG_SPL_GPIO=y
CONFIG_SPL_LIBCOMMON_SUPPORT=y
CONFIG_SPL_LIBGENERIC_SUPPORT=y
CONFIG_NR_DRAM_BANKS=1
CONFIG_ENV_SIZE=0x4000
CONFIG_ENV_OFFSET=0x300000
CONFIG_DM_GPIO=y
CONFIG_DEFAULT_DEVICE_TREE="imx28-lertu"
CONFIG_SPL_TEXT_BASE=0x00001000
CONFIG_TARGET_LERTUIMX28=y
CONFIG_SPL_SERIAL=y
CONFIG_SPL=y
CONFIG_ENV_OFFSET_REDUND=0x380000
CONFIG_SYS_LOAD_ADDR=0x42000000
# CONFIG_LOCALVERSION_AUTO is not set
CONFIG_ENV_VARS_UBOOT_CONFIG=y
CONFIG_FIT=y
CONFIG_TIMESTAMP=y
# CONFIG_BOOTSTD is not set
CONFIG_BOOTDELAY=3
CONFIG_USE_BOOTARGS=y
CONFIG_BOOTARGS="console=ttyAMA0,115200n8 "
CONFIG_USE_BOOTCOMMAND=y
CONFIG_BOOTCOMMAND="run boot_command"
CONFIG_LOGLEVEL=7
CONFIG_BOARD_EARLY_INIT_F=y
CONFIG_LAST_STAGE_INIT=y
# CONFIG_SPL_FRAMEWORK is not set
CONFIG_SPL_NO_BSS_LIMIT=y
CONFIG_SPL_NO_CPU_SUPPORT=y
CONFIG_HUSH_PARSER=y
CONFIG_CMD_MEM_SEARCH=y
CONFIG_CMD_GPIO=y
CONFIG_CMD_MMC=y
CONFIG_CMD_MTD=y
CONFIG_CMD_NAND=y
CONFIG_CMD_NAND_TRIMFFS=y
CONFIG_CMD_SETEXPR=y
CONFIG_CMD_NET=y
CONFIG_CMD_DHCP=y
CONFIG_CMD_NFS=y
CONFIG_CMD_MII=y
CONFIG_CMD_PING=y
CONFIG_CMD_CACHE=y
CONFIG_CMD_EXT4=y
CONFIG_CMD_EXT4_WRITE=y
CONFIG_CMD_FAT=y
CONFIG_CMD_FS_GENERIC=y
CONFIG_MTDIDS_DEFAULT="nand0=gpmi-nand"
CONFIG_MTDPARTS_DEFAULT="mtdparts=gpmi-nand:3m(u-boot),512k(env1),512k(env2),4m(boot),248m(data),252m@4096k(UBI)"
CONFIG_OF_CONTROL=y
CONFIG_ENV_IS_IN_NAND=y
CONFIG_ENV_RANGE=0x80000
CONFIG_SYS_REDUNDAND_ENVIRONMENT=y
CONFIG_ENV_APPEND=y
CONFIG_USE_BOOTFILE=y
CONFIG_BOOTFILE="uImage"
CONFIG_VERSION_VARIABLE=y
CONFIG_USE_IPADDR=y
CONFIG_IPADDR="192.168.2.55"
CONFIG_USE_NETMASK=y
CONFIG_NETMASK="255.255.255.0"
CONFIG_DM=y
CONFIG_MXS_GPIO=y
CONFIG_MMC_MXS=y
CONFIG_MTD=y
CONFIG_MTD_RAW_NAND=y
CONFIG_NAND_MXS=y
CONFIG_PHYLIB=y
CONFIG_DM_ETH=y
CONFIG_FEC_MXC_SHARE_MDIO=y
CONFIG_FEC_MXC_MDIO_BASE=0x800F0000
CONFIG_FEC_MXC=y
CONFIG_MII=y
CONFIG_CONS_INDEX=0
CONFIG_FAT_WRITE=y
```
